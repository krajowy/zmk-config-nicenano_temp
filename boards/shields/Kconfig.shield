## boards/shields/Kconfig.shield
```kconfig
# Copyright (c) 2022 The ZMK Contributors
# SPDX-License-Identifier: MIT

config SHIELD_KRALARM
    def_bool $(shields_list_contains,kralarm)
```

## boards/shields/kraBoardX/Kconfig.defconfig
```kconfig
# Copyright (c) 2022 The ZMK Contributors
# SPDX-License-Identifier: MIT

if SHIELD_KRABOARDX

config ZMK_KEYBOARD_NAME
    default "kraBoardX"

endif
```

## boards/shields/kraBoardX/Kconfig.shield
```kconfig
# Copyright (c) 2022 The ZMK Contributors
# SPDX-License-Identifier: MIT

config SHIELD_KRABOARDX
    def_bool $(shields_list_contains,kraBoardX)
```

## boards/shields/kralarm/Kconfig.defconfig
```kconfig
# Copyright (c) 2022 The ZMK Contributors
# SPDX-License-Identifier: MIT

if SHIELD_KRALARM

config ZMK_KEYBOARD_NAME
    default "kralarm"

endif
```
